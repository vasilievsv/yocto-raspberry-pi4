## bsp/meta-my-rpi64/conf/layer.conf
```bitbake
# We have a conf and classes directory, append to BBPATH
BBPATH .= ":${LAYERDIR}"

# We have a recipes directory, add to BBFILES
BBFILES += "${LAYERDIR}/recipes*/*/*.bb ${LAYERDIR}/recipes*/*/*.bbappend ${LAYERDIR}/images/*.bb"

BBFILE_COLLECTIONS += "meta-mybox-rpi64"
BBFILE_PATTERN_meta-mybox-rpi64 := "^${LAYERDIR}/"
BBFILE_PRIORITY_meta-mybox-rpi64 = "16"

# ENABLEUSB device mode
ENABLE_DWC2_PERIPHERAL = "1"
LAYERSERIES_COMPAT_meta-mybox-rpi64 = "dunfell"
```

## build/conf/local.conf
```bitbake
# Local configuration for meta-rpi images
# Yocto Project 3.1 Poky distribution [dunfell] branch
# This is a sysvinit system

# mask wireguard from meta-openembedded/meta-networking
# use version in meta-jumpnow to support kernels < 5.6
# with wireguard-linux-compat
BBMASK = "meta-networking/recipes-kernel/wireguard"

LICENSE_FLAGS_WHITELIST = "commercial"

# ENABLE systemd
DISTRO_FEATURES = "ext2 x11 opengl usb-gadget ${DISTRO_FEATURES_LIBC} systemd virtualization "

# ADD SYSVINIT
DISTRO_FEATURES_BACKFILL_CONSIDERED += "pulseaudio sysvinit"

PREFERRED_PROVIDER_jpeg = "libjpeg-turbo"
PREFERRED_PROVIDER_jpeg-native = "libjpeg-turbo-native"

PREFERRED_PROVIDER_udev = "eudev"
VIRTUAL-RUNTIME_init_manager = "systemd"

MACHINE_FEATURES_remove = "apm"

IMAGE_FSTYPES = "tar.xz"

MACHINE = "raspberrypi4-64"
#ENABLE_DWC2_PERIPHERAL = "1"
CORE_IMAGE_EXTRA_INSTALL += " kernel-modules"


PREFERRED_VERSION_mono = "4.8.1.0"
PREFERRED_VERSION_mono-native = "4.8.1.0"

#PREFERRED_VERSION_xserver-nodm-init = "2.0"

#KERNEL_MODULE_AUTOLOAD += "dwc2 g_ether usb_f_ecm usb_f_eem"
#MACHINE_ESSENTIAL_EXTRA_RDEPENDS += "kernel-module-dwc2 kernel-module-g-ether kernel-module-usb-f-ecm kernel-module-usb-f-eem"
SYSTEMD_AUTO_ENABLE = "enable"

KERNEL_IMAGETYPE = "Image"


# uncomment for kernels < 5.6
WIREGUARD_COMPAT = "1"
DISABLE_OVERSCAN = "1"

ENABLE_UART = "1"
ENABLE_RPI3_SERIAL_CONSOLE = "1"
BAUDRATE_UART = "115200"


#SYSVINIT_ENABLED_GETTYS = "GS0"
#SERIAL_CONSOLES = "115200;ttyAMA0"





# default to 5.4
#PREFERRED_VERSION_linux-raspberrypi = "5.4.%"
PREFERRED_VERSION_linux-raspberrypi = "4.19.%"

# DL_DIR = "/src/oe"
# SSTATE_DIR = "/oe8/rpi64/sstate-cache"
# TMPDIR = "/oe8/rpi64/tmp-zeus"

DISTRO = "poky"
PACKAGE_CLASSES ?= "package_deb"

# i686 or x86_64
SDKMACHINE = "x86_64"

# for no root passwd uncomment the following and comment the two extra user lines
EXTRA_IMAGE_FEATURES = "debug-tweaks"

# for a root passwd, change root below to your password
INHERIT += "extrausers"
EXTRA_USERS_PARAMS = "usermod -P root root; "

# this will force root to change password on first login
#INHERIT += "chageusers"
#CHAGE_USERS_PARAMS = "chage -d0 root; "

USER_CLASSES = "image-mklibs image-prelink"
PATCHRESOLVE = "noop"
RM_OLD_IMAGE = "1"
INHERIT += "rm_work"
CONF_VERSION = "1"
PACKAGE_FEED_URIS = "http://<local-machine-ip>:5678"
```

## layers/meta-os-tune/conf/layer.conf
```bitbake
# We have a conf and classes directory, append to BBPATH
BBPATH .= ":${LAYERDIR}"

BBFILES += "${LAYERDIR}/recipes*/*/*.bb ${LAYERDIR}/recipes*/*/*.bbappend ${LAYERDIR}/images/*.bb"

BBFILE_COLLECTIONS += "meta-fixes"
BBFILE_PATTERN_meta-fixes := "^${LAYERDIR}/"
BBFILE_PRIORITY_meta-fixes = "12"

LAYERSERIES_COMPAT_meta-fixes = "dunfell"
```
